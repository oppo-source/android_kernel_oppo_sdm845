## drivers/power/Kconfig
```kconfig
source "drivers/power/avs/Kconfig"
source "drivers/power/reset/Kconfig"
source "drivers/power/supply/Kconfig"
source "drivers/power/qcom/Kconfig"

#ifdef VENDOR_EDIT
config OPLUS_SDM845_CHARGER
	tristate "OPLUS SDM845 charger driver"
	depends on MFD_SPMI_PMIC
	help
	  Enables support for the oppo charging framework

config OPLUS_SDM845P_CHARGER
	tristate "OPLUS SDM845 charger driver"
	depends on MFD_SPMI_PMIC
	help
	  Enables support for the oppo charging framework
config OPLUS_SDM845_Q_CHARGER
	tristate "OPLUS SDM845 Q charger driver"
	depends on MFD_SPMI_PMIC
	help
	  Enables support for the oppo Q charging framework
config OPLUS_SHORT_C_BATT_CHECK
	tristate "OPLUS_SHORT_C_BATT CHECK SUPPORT"
	default n
	depends on MFD_SPMI_PMIC
	help
	  Say Y to include support

config OPLUS_RTC_DET_SUPPORT
	tristate "OPLUS RTC DET SUPPORT"
	default n
	depends on MFD_SPMI_PMIC
	help
	  Say Y to include support

config OPLUS_CHECK_CHARGERID_VOLT
	tristate "OPLUS CHECK CHARGERID VOLT"
	default n
	depends on MFD_SPMI_PMIC
	help
	  Say Y to include support

config OPLUS_SHIP_MODE_SUPPORT
	tristate "OPLUS_SHIP_MODE_SUPPORT"
	default n
	depends on MFD_SPMI_PMIC
	help
	  Say Y to include support
config OPLUS_SHORT_HW_CHECK
	bool "OPLUS batt HW SHORT "
	help
	  Say Y to include support
config OPLUS_SHORT_USERSPACE
	bool "OPLUS batt userspace"
	help
	  Say Y to include support
source "drivers/power/oppo/Kconfig"
#endif
```

## drivers/soc/Kconfig
```kconfig
menu "SOC (System On Chip) specific Drivers"

source "drivers/soc/bcm/Kconfig"
source "drivers/soc/fsl/qbman/Kconfig"
source "drivers/soc/fsl/qe/Kconfig"
source "drivers/soc/mediatek/Kconfig"
source "drivers/soc/qcom/Kconfig"
source "drivers/soc/rockchip/Kconfig"
source "drivers/soc/samsung/Kconfig"
source "drivers/soc/sunxi/Kconfig"
source "drivers/soc/tegra/Kconfig"
source "drivers/soc/ti/Kconfig"
source "drivers/soc/ux500/Kconfig"
source "drivers/soc/versatile/Kconfig"
source "drivers/soc/oppo/Kconfig"

source "drivers/soc/oplus/Kconfig"

#ifdef OPLUS_FEATURE_POWERINFO_STANDBY
source "drivers/soc/oplus/owakelock/Kconfig"
#endif /* OPLUS_FEATURE_POWERINFO_STANDBY */
endmenu
```

## drivers/soc/oplus/Kconfig
```kconfig
source "drivers/soc/oplus/system/Kconfig"
#endif /* VENDOR_EDIT */

#ifdef OPLUS_FEATURE_THERMAL_HORAE
source "drivers/soc/oplus/thermal/Kconfig"
#endif /* OPLUS_FEATURE_THERMAL_HORAE */

source "drivers/soc/oplus/oplus_healthinfo/Kconfig"
```

## drivers/soc/oppo/oppo_hypnus/Kconfig
```kconfig
# ifdef VENDOR_EDIT
config HYPNUS_HELPER
bool "config hypnus helper"
help
    Provide helper functions for hypnus.
#endif /* VENDOR_EDIT */
```
